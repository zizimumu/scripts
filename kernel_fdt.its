## kernel_fdt.its
```
/*
 * Simple U-Boot uImage source file containing a single kernel and FDT blob
 */

/dts-v1/;

/ {
	description = "Simple image with single Linux kernel and FDT blob";
	#address-cells = <1>;

	images {
		kernel {
			description = "Linux kernel";
			data = /incbin/("./arch/arm/boot/zImage");
			type = "kernel";
			arch = "arm";
			os = "linux";
			compression = "none";
			load = <0x20008000>;
			entry = <0x20008000>;
			
			hash-1 {
				algo = "crc32";
			};
			/* hash-2 can be removed*/
			hash-2 {
				algo = "sha1";
			};
		};
		fdt_base {
			description = "Flattened Device Tree blob";
			data = /incbin/("./arch/arm/boot/dts/at91-sama5d2_xplained.dtb");
			type = "flat_dt";
			arch = "arm";
			compression = "none";
			hash-1 {
				algo = "crc32";
			};
			/* hash-2 can be removed*/
			hash-2 {
				algo = "sha1";
			};
		};
		fdt_pda4 {
			description = "Device Tree blob pda4300 overlay";
			data = /incbin/("./arch/arm/boot/dts/at91-sama5d2_xplained_pda4.dtb");
			type = "flat_dt";
			arch = "arm";
			compression = "none";
			load = <0x23130000>;
			hash@1 {
				algo = "crc32";
			};
			hash@2 {
				algo = "sha1";
			};
		};
	};

	configurations {
		default = "conf-base";
		conf-base {
			description = "Boot Linux kernel with FDT blob";
			kernel = "kernel";
			fdt = "fdt_base";
		};
		conf-pda4 {
			description = "Boot Linux kernel with FDT blob";
			kernel = "kernel";
			fdt = "fdt_pda4";
		};
	};
};
```
